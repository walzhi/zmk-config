## Kconfig
```kconfig
config PALJETT_ACCEL
    bool "Paljett pointer acceleration"
    default y
    depends on ZMK_POINTING

config PALJETT_SENSOR_SLEEP
    bool "Shut down the Paljett sensor before system deep sleep"
    default y
    depends on ZMK_SLEEP && ZMK_POINTING && SPI
    select PM_DEVICE
    help
      Send the Pinnacle shutdown command before ZMK powers off the XIAO.
      No sensor readback is performed after shutdown. Hardware reset restarts
      both the MCU and the sensor. USB diagnostics with ZMK_SLEEP=n do not
      enable this feature.

config PALJETT_SENSOR_POWER_TEST
    bool "Paljett USB sensor shutdown diagnostic"
    default n
    depends on ZMK_POINTING && SPI
    select HWINFO
    help
      Keep USB and Bluetooth awake while testing the sensor shutdown command.
      After 30 seconds without touch, shut down the sensor until hardware reset.
      This diagnostic does not test whole-board deep sleep or measure current.
```

## dts/bindings/zmk,input-processor-paljett-accel.yaml
```yaml
description: Paljett pointer acceleration
compatible: "zmk,paljett-accel"
include: ip_zero_param.yaml
properties:
  min-factor:
    type: int
    default: 700
  max-factor:
    type: int
    default: 4000
  speed-max:
    type: int
    default: 40
```
